## config/west.yml
```yaml
manifest:
  remotes:
    - name: zmk
      url-base: https://github.com/Keychron
    # Additional modules containing boards/shields/custom code can be listed here as well
    # See https://docs.zephyrproject.org/3.2.0/develop/west/manifest.html#projects
  projects:
    - name: zmk
      remote: zmkfirmware
      revision: keychron_bpro
      import: app/west.yml
  self:
    path: config
```
